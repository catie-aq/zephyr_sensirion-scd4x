## drivers/Kconfig
```kconfig
# Copyright (c) 2024 CATIE
# SPDX-License-Identifier: Apache-2.0

menu "Drivers"
rsource "sensor/Kconfig"
endmenu
```

## drivers/sensor/Kconfig
```kconfig
# Copyright (c) 2024 CATIE
# SPDX-License-Identifier: Apache-2.0

if SENSOR
rsource "scd4x/Kconfig"
endif # SENSOR
```

## drivers/sensor/scd4x/Kconfig
```kconfig
# SCD4X driver configuration

# Copyright (c) 2024 CATIE
# SPDX-License-Identifier: Apache-2.0

config SCD4X
	bool "Example sensor"
	default y
	depends on DT_HAS_SENSIRION_SCD4X_ENABLED
	select I2C
	help
	  Enable example sensor
```

## drivers/sensor/sensirion/Kconfig
```kconfig
# Copyright (c) 2024 CATIE
# SPDX-License-Identifier: Apache-2.0

rsource "scd4x/Kconfig"
```
